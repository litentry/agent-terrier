## firmware/esp32s3-agentkeys/sdkconfig.defaults
```kconfig
# AgentKeys ESP32-S3 demo firmware — ESP-IDF defaults
# Plan: docs/spec/plans/issue-103-aiosandbox-hermes-esp32-demo.md

# --- USB CDC console (native USB-OTG, no UART chip needed) ---
CONFIG_ESP_CONSOLE_USB_CDC=y
CONFIG_ESP_CONSOLE_USB_CDC_SUPPORT_ETS_PRINTF=y
CONFIG_ESP_CONSOLE_USB_CDC_RX_BUF_SIZE=1024

# --- PSRAM (8MB external octal) — required for voice follow-up audio buffers ---
CONFIG_SPIRAM=y
CONFIG_SPIRAM_MODE_OCT=y
CONFIG_SPIRAM_SPEED_80M=y
CONFIG_SPIRAM_USE_MALLOC=y
CONFIG_SPIRAM_MALLOC_ALWAYSINTERNAL=16384
CONFIG_SPIRAM_TRY_ALLOCATE_WIFI_LWIP=y

# --- mbedTLS — bundle Mozilla CA root certs for HTTPS to AWS / Cloudflare ---
CONFIG_MBEDTLS_CERTIFICATE_BUNDLE=y
CONFIG_MBEDTLS_CERTIFICATE_BUNDLE_DEFAULT_FULL=y
CONFIG_MBEDTLS_ASYMMETRIC_CONTENT_LEN=y

# --- WiFi ---
CONFIG_ESP_WIFI_ENABLE_WPA3_SAE=y
CONFIG_ESP_WIFI_PMF_OPTIONAL=y
CONFIG_ESP_WIFI_TX_BUFFER_TYPE=1
CONFIG_ESP_WIFI_STATIC_TX_BUFFER_NUM=16

# --- Flash (8MB typical for DevKitC-1) ---
CONFIG_ESPTOOLPY_FLASHSIZE_8MB=y
CONFIG_ESPTOOLPY_FLASHSIZE="8MB"
CONFIG_ESPTOOLPY_FLASHMODE_QIO=y

# --- FreeRTOS ---
CONFIG_FREERTOS_HZ=1000
CONFIG_FREERTOS_USE_TRACE_FACILITY=y

# --- Logging (INFO during dev; switch to WARN/ERROR for production) ---
CONFIG_LOG_DEFAULT_LEVEL_INFO=y
CONFIG_LOG_COLORS=y

# --- Partition table (NVS + factory + OTA) ---
CONFIG_PARTITION_TABLE_CUSTOM=y
CONFIG_PARTITION_TABLE_CUSTOM_FILENAME="partitions.csv"

# --- HTTP client (used by https_chat.c) ---
CONFIG_ESP_HTTP_CLIENT_ENABLE_HTTPS=y
CONFIG_ESP_HTTP_CLIENT_ENABLE_BASIC_AUTH=y
```

## firmware/esp32s3-touch-lcd-4b/sdkconfig.defaults
```kconfig
# ESP-IDF defaults for the Waveshare ESP32-S3-Touch-LCD-4B.
# The BSP (waveshare/esp32_s3_touch_lcd_4b) drives ST7701 RGB + GT911 + ES8311; these
# defaults give it the memory + LVGL features it needs. Tune SPIRAM speed up to 120M if
# the RGB panel tears (needs CONFIG_ESPTOOLPY_FLASHFREQ_120M + Flash in DIO).

CONFIG_IDF_TARGET="esp32s3"

# 16 MB external flash
CONFIG_ESPTOOLPY_FLASHSIZE_16MB=y
CONFIG_ESPTOOLPY_FLASHSIZE="16MB"

# 8 MB octal PSRAM — the RGB framebuffer + LVGL draw buffers live here
CONFIG_SPIRAM=y
CONFIG_SPIRAM_MODE_OCT=y
CONFIG_SPIRAM_SPEED_80M=y
CONFIG_SPIRAM_FETCH_INSTRUCTIONS=y
CONFIG_SPIRAM_RODATA=y

CONFIG_ESP_DEFAULT_CPU_FREQ_MHZ_240=y

# Custom partition layout (single factory app, no OTA, + a spiffs assets partition)
CONFIG_PARTITION_TABLE_CUSTOM=y
CONFIG_PARTITION_TABLE_CUSTOM_FILENAME="partitions.csv"

# Bundle the common CA roots so HTTPS to the broker + agent works without per-cert pinning
CONFIG_MBEDTLS_CERTIFICATE_BUNDLE=y
CONFIG_MBEDTLS_CERTIFICATE_BUNDLE_DEFAULT_FULL=y

# LVGL: enable the QR-code widget (the real pairing deep-link QR) + the fonts the UI uses
CONFIG_LV_USE_QRCODE=y
CONFIG_LV_FONT_MONTSERRAT_16=y
CONFIG_LV_FONT_MONTSERRAT_20=y
CONFIG_LV_FONT_MONTSERRAT_28=y

# Headroom for the UI build on the main task
CONFIG_ESP_MAIN_TASK_STACK_SIZE=8192
```
